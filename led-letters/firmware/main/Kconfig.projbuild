## led-letters/firmware/main/Kconfig.projbuild
```kconfig
menu "LED letters"

    config LETTERS_OUT_GPIOS
        string "Output GPIOs, OUT 1 first (comma separated)"
        default "4,5,6,7,15,16,17,18,8,9,10,11,12,13,14,21"
        help
            One data output per letter, in the order of the letters in the
            text. Up to 8 letters use the first 8 pins (8-bit LCD bus); 9 to 16
            letters use all 16. Every listed pin of the bus is driven, even if
            no letter is plugged into it. Each output goes through a 74AHCT245
            level shifter and a 100 ohm series resistor. Avoid strapping pins
            (0, 3, 45, 46), USB (19, 20) and flash/PSRAM pins (26-37).

    config LETTERS_BUS_WR_GPIO
        int "LCD bus clock (WR) GPIO -- leave unconnected"
        range 0 48
        default 2
        help
            The parallel output uses the LCD peripheral, which needs a clock
            pin even though the LEDs don't use it. Pick a free pin; nothing is
            connected to it.

    config LETTERS_BUS_DC_GPIO
        int "LCD bus D/C GPIO -- leave unconnected"
        range 0 48
        default 1

    config LETTERS_BUTTON_GPIO
        int "Button GPIO (active low)"
        range 0 48
        default 0
        help
            Short press: next effect. Long press: brightness step. GPIO 0 is the
            BOOT button on ESP32-S3 DevKits.

    config LETTERS_DEFAULT_BRIGHTNESS
        int "Default brightness (0-255)"
        range 0 255
        default 128

    config LETTERS_FPS
        int "Frames per second"
        range 10 120
        default 50

    choice LETTERS_COLOR_ORDER
        prompt "Pixel colour order"
        default LETTERS_COLOR_ORDER_GRB
        help
            WS2812B is GRB. Some 12 mm bullet pixels are RGB: if red and green
            look swapped, pick RGB.
        config LETTERS_COLOR_ORDER_GRB
            bool "GRB (WS2812B)"
        config LETTERS_COLOR_ORDER_RGB
            bool "RGB"
    endchoice

    config LETTERS_WIFI_AP
        bool "Wi-Fi access point + web control page"
        default y

    config LETTERS_AP_SSID
        string "Access point name"
        default "LETRAS-LED"
        depends on LETTERS_WIFI_AP

    config LETTERS_AP_PASSWORD
        string "Access point password (8+ characters, change it!)"
        default "cambiar-esta-clave"
        depends on LETTERS_WIFI_AP

    config LETTERS_AP_CHANNEL
        int "Wi-Fi channel"
        range 1 13
        default 6
        depends on LETTERS_WIFI_AP

endmenu
```
