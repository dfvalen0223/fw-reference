// LED letters -- ESP32-S3 + WS2812B 12 mm pixel strings.
//
// Each letter stands on its own with its own 5 V supply and one data cable
// from this controller (OUT 1..N), all driven in parallel (see output.c).
// The pixel layout comes from letters_config.h, generated by cad/generate.py
// from the same run that produced the STL files, so effects are drawn by
// physical position and each letter is kept within its supply's budget.
//
// Controls: BOOT button short press = next effect, long press = brightness
// step. Wi-Fi access point + web page for everything else (see web.c).
#include <string.h>

#include "driver/gpio.h"
#include "esp_log.h"
#include "esp_timer.h"
#include "freertos/FreeRTOS.h"
#include "freertos/task.h"
#include "sdkconfig.h"

#include "effects.h"
#include "letters_config.h"
#include "output.h"
#include "power.h"
#include "settings.h"
#include "web.h"

#if LED_TOTAL_COUNT == 0
#error "letters_config.h has no pixels: re-run cad/generate.py"
#endif

static const char *TAG = "letters";

#define LONG_PRESS_MS 800

static rgb_t s_frame[LED_TOTAL_COUNT];
static rgb_t s_out[LED_TOTAL_COUNT];

static const fx_layout_t LAYOUT = {
    .map = LED_MAP,
    .count = LED_TOTAL_COUNT,
    .letters = LED_LETTERS,
    .letter_count = LED_LETTER_COUNT,
    .width_mm = LED_WORD_WIDTH_MM,
    .height_mm = LED_WORD_HEIGHT_MM,
};

static void button_init(void)
{
    gpio_config_t io = {
        .pin_bit_mask = 1ULL << CONFIG_LETTERS_BUTTON_GPIO,
        .mode = GPIO_MODE_INPUT,
        .pull_up_en = GPIO_PULLUP_ENABLE,
    };
    ESP_ERROR_CHECK(gpio_config(&io));
}

// Polled once per frame: short press -> next effect, long press -> brightness step.
static void button_poll(uint32_t now_ms)
{
    static bool was_down;
    static uint32_t down_since;
    static bool long_fired;
    bool down = gpio_get_level(CONFIG_LETTERS_BUTTON_GPIO) == 0;

    if (down && !was_down) {
        down_since = now_ms;
        long_fired = false;
    } else if (down && !long_fired && now_ms - down_since >= LONG_PRESS_MS) {
        static const uint8_t steps[] = {16, 48, 96, 160, 255};
        app_settings_t s = settings_get();
        size_t k = 0;
        while (k < sizeof(steps) && steps[k] <= s.brightness) k++;
        s.brightness = steps[k % sizeof(steps)];
        settings_set(&s);
        long_fired = true;
        ESP_LOGI(TAG, "brightness %u", s.brightness);
    } else if (!down && was_down && !long_fired && now_ms - down_since > 30) {
        app_settings_t s = settings_get();
        s.fx.effect = (fx_id_t)((s.fx.effect + 1) % FX_COUNT);
        settings_set(&s);
        ESP_LOGI(TAG, "effect %s", fx_name(s.fx.effect));
    }
    was_down = down;
}

void app_main(void)
{
    ESP_LOGI(TAG, "%d letters, %d pixels", LED_LETTER_COUNT, LED_TOTAL_COUNT);
    settings_init();
    ESP_ERROR_CHECK(output_init(LED_LETTERS, LED_LETTER_COUNT));
    button_init();
#if CONFIG_LETTERS_WIFI_AP
    web_start(&LAYOUT);
#endif

    const TickType_t period = pdMS_TO_TICKS(1000 / CONFIG_LETTERS_FPS);
    TickType_t wake = xTaskGetTickCount();
    for (;;) {
        uint32_t now_ms = (uint32_t)(esp_timer_get_time() / 1000);
        button_poll(now_ms);
        app_settings_t s = settings_get();

        fx_render(&s.fx, &LAYOUT, now_ms, s_frame);
        // Each letter has its own supply, so each gets its own current budget.
        uint32_t ma = 0;
        for (int l = 0; l < LED_LETTER_COUNT; l++) {
            const led_letter_t *le = &LED_LETTERS[l];
            ma += power_finalize(&s_frame[le->first_led], &s_out[le->first_led], le->led_count, s.brightness,
                                 le->max_ma);
        }
        if (output_show(s_out) != ESP_OK) ESP_LOGW(TAG, "frame dropped");
        settings_publish_ma(ma);
        settings_save_if_dirty(now_ms);

        xTaskDelayUntil(&wake, period ? period : 1);
    }
}
